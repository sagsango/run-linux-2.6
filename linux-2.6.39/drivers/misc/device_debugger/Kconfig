## linux-2.6.39/drivers/misc/device_debugger/Kconfig
```kconfig
config DEVICE_DEBUGGER
	tristate "Device debugger by Sagar"
	default y
	help
	  Provides a character device for triggering Linux driver
	  debugging operations from userspace.

	  This driver is intended for debugging and experimentation
	  with the Linux device-management subsystem.
```

## linux-2.6.39/drivers/misc/iommu_debugger/Kconfig
```kconfig
config IOMMU_DEBUGGER
	tristate "IOMMU debugger"
	depends on DMAR
	depends on DEBUG_FS
	help
	  Debugging interface for Intel IOMMU experiments.
```

## linux-2.6.39/drivers/misc/mem_debugger/Kconfig
```kconfig
config MEM_DEBUGGER
	tristate "Memory debugger by Sagar"
	default y
	help
	  Provides a character device for triggering Linux memory
	  debugging operations from userspace.

	  This driver is intended for debugging and experimentation
	  with the Linux memory-management subsystem.
```

## linux-2.6.39/drivers/misc/rcu_experiment/Kconfig
```kconfig
config RCU_EXPERIMENT
	tristate "Linux 2.6.39 RCU Subsystem Experimental Module"
	default m
	help
	  This option enables a multi-threaded testing environment for
	  evaluating synchronous and asynchronous RCU primitives.
```

## linux-2.6.39/drivers/misc/rt_lock_test/Kconfig
```kconfig
config RT_LOCK_TEST
	tristate "RT mutex PI/deadlock test"
	depends on DEBUG_FS
	depends on RT_MUTEXES
	help
	  Creates 16 kernel threads and 16 RT mutexes.

	  Each thread acquires one mutex and then attempts
	  to acquire the next mutex, creating a circular
	  dependency.

	  This is intended for RT mutex, priority inheritance,
	  and lock dependency debugging experiments.
```
